AUTOSAR XML (schema 4-1-1)
package /ARRoot
  ecuc value collection VCU: ecu-extract=demo_VCU_Extract_v4EcuExtract, ecuc-values=[Com, Os, Rte, EcuC, PduR, CanIf, Can, CanTp]
  module config Nm: implementation-config-variant=VARIANT-POST-BUILD, module-description=Nm
  module config NvM: implementation-config-variant=VARIANT-POST-BUILD, module-description=NvM
  module config Os: implementation-config-variant=VARIANT-POST-BUILD, module-description=Os
  module config PduR: implementation-config-variant=VARIANT-POST-BUILD, module-description=PduR
  module config Rte: implementation-config-variant=VARIANT-POST-BUILD, module-description=Rte
  module config SoAd: implementation-config-variant=VARIANT-POST-BUILD, module-description=SoAd
  module config UdpNm: implementation-config-variant=VARIANT-POST-BUILD, module-description=UdpNm
  module config WdgIf: implementation-config-variant=VARIANT-POST-BUILD, module-description=WdgIf
  module config WdgM: implementation-config-variant=VARIANT-POST-BUILD, module-description=WdgM
  module config J1939Tp: implementation-config-variant=VARIANT-POST-BUILD, module-description=J1939Tp
  module config LinIf: implementation-config-variant=VARIANT-POST-BUILD, module-description=LinIf
  module config LinSM: implementation-config-variant=VARIANT-POST-BUILD, module-description=LinSM
  module config LwIp: implementation-config-variant=VARIANT-POST-BUILD, module-description=LwIp
  module config MemIf: implementation-config-variant=VARIANT-POST-BUILD, module-description=MemIf
  module config IoHwAb: implementation-config-variant=VARIANT-POST-BUILD, module-description=IoHwAb
  module config IpduM: implementation-config-variant=VARIANT-POST-BUILD, module-description=IpduM
  module config Det: implementation-config-variant=VARIANT-POST-BUILD, module-description=Det
  module config EcuC: implementation-config-variant=VARIANT-POST-BUILD, module-description=EcuC
  module config Fee: implementation-config-variant=VARIANT-POST-BUILD, module-description=Fee
  module config CanSM: implementation-config-variant=VARIANT-POST-BUILD, module-description=CanSM
  module config CanTp: implementation-config-variant=VARIANT-POST-BUILD, module-description=CanTp
  module config Com: implementation-config-variant=VARIANT-POST-BUILD, module-description=Com
  module config ComM: implementation-config-variant=VARIANT-POST-BUILD, module-description=ComM
  module config Crc: implementation-config-variant=VARIANT-POST-BUILD, module-description=Crc
  module config Dcm: implementation-config-variant=VARIANT-POST-BUILD, module-description=Dcm
  module config Dem: implementation-config-variant=VARIANT-POST-BUILD, module-description=Dem
  module config BswM: implementation-config-variant=VARIANT-POST-BUILD, module-description=BswM
  module config CanIf: implementation-config-variant=VARIANT-POST-BUILD, module-description=CanIf
  module config CanNm: implementation-config-variant=VARIANT-POST-BUILD, module-description=CanNm
