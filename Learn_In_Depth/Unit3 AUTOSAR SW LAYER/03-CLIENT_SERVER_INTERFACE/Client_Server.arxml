AUTOSAR XML (schema 00046)
package /CR_Interfaces_Lab
  client server interface IF_SUM
    operation SUM
      arg IN1: type=uint16, direction=IN
      arg IN2: type=uint16, direction=IN
      arg Result: type=uint32, direction=OUT
  application sw component type Server_Sum_Cmp
    provide port CS_Psum: client-server-annotation=SUM
  application sw component type Client_Sum_Cmp
    require port CS_Rsum: client-server-annotation=SUM
