AUTOSAR XML (schema 00046)
package /Interfaces_Lab
  sender receiver interface SRI1
    data Lidar_Data: type=uint32, init-value=12
  sensor actuator sw component type Lidar_Provider_SWC1
    provide port Sender: provided-interface=SRI1
  application sw component type Lidar_Algo_SWC2
    require port Receiver: required-interface=SRI1
