AUTOSAR XML (schema 00046)
package /SWCs_EABS_Packgae
  sensor actuator sw component type LADIER_SWC1
  sensor actuator sw component type SpeedSensor_SWC2
  ecu abstraction sw component type ECUAbstract_SWC3
  application sw component type EABS_SWC4
  parameter sw component type P_Threshold_SWC5
  sensor actuator sw component type LED_Warning_SWC6
  complex device driver sw component type Breaking_CDD_SWC7
  service sw component type Diagonastic_service_SWC8
  nv block sw component type Flash_NVBlock_SWC9
